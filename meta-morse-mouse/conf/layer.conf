## meta-morse-mouse/conf/layer.conf
```bitbake
# MorseMouse Yocto Layer Configuration

# Add this layer to BitBake's search path.
BBPATH .= ":${LAYERDIR}"

# Discover recipes and append files.
BBFILES += "${LAYERDIR}/recipes-*/*/*.bb \
            ${LAYERDIR}/recipes-*/*/*.bbappend"

# Layer identification.
BBFILE_COLLECTIONS += "morse"
BBFILE_PATTERN_morse = "^${LAYERDIR}/"
BBFILE_PRIORITY_morse = "6"

# Supported Yocto release.
LAYERSERIES_COMPAT_morse = "scarthgap"
```
